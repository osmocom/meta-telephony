## conf/layer.conf
```bitbake
# We have a conf and classes directory, add to BBPATH
BBPATH := "${BBPATH}:${LAYERDIR}"

# We have a packages directory, add to BBFILES
BBFILES := "${BBFILES} ${LAYERDIR}/recipes-*/*/*.bb \
            ${LAYERDIR}/recipes-*/*/*.bbappend"

BBFILE_COLLECTIONS += "telephony"
BBFILE_PATTERN_telephony := "^${LAYERDIR}/"
BBFILE_PRIORITY_telephony = "5"

META_TELEPHONY_OSMO_INC = "4"
```
